#include <Wire.h>                // Подключаем библиотеку для работы с I2C
#include "paj7620.h"            // Подключаем библиотеку для работы с жестами (Paj7620)
#include <SoftwareSerial.h>     // Подключаем библиотеку для создания программного последовательного порта

// Определяем пины для программного последовательного порта (RX, TX)
SoftwareSerial BT201(3, 2);    

void setup() {
    uint8_t error = 0;          // Переменная для хранения кода ошибки

    Serial.begin(115200);         // Инициализация аппаратного последовательного порта на скорости 9600 бод
    error = paj7620Init();      // Инициализация сенсора жестов Paj7620
    if (error) {                // Проверка на наличие ошибки при инициализации
        Serial.print("Статус: ошибка, Код:"); 
        Serial.println(error);   // Вывод кода ошибки в последовательный порт
    } else {
        Serial.println("Статус: OK"); // Вывод статуса инициализации
    }

    BT201.begin(115200);          // Инициализация программного последовательного порта на скорости 9600 бод
    // BT201.println("AT");        // Отправка команды AT для проверки связи с устройством
    delay(500);
}

void loop() {
    uint8_t data = 0;           // Переменная для хранения данных, полученных от сенсора жестов
    uint8_t error;              // Переменная для хранения кода ошибки

    // Проверка наличия данных от Bluetooth модуля
    if (BT201.available()) {     
        Serial.write(BT201.read()); // Чтение данных и вывод их в последовательный порт
    }    

    // Проверка наличия команд из последовательного порта
    if (Serial.available()) {     
        BT201.write(Serial.read()); // Чтение команды и отправка её в Bluetooth модуль
    }

    // Чтение данных из регистра сенсора жестов
    error = paj7620ReadReg(0x43, 1, &data);
    
    // Обработка полученных данных (жестов)
    switch (data) {
        case GES_LEFT_FLAG:         // Если жест "влево"
            Serial.println("Лево (Предыдущий трек)"); 
            BT201.println("AT+CD"); // Отправка команды для перехода на предыдущий трек
            break;
        case GES_RIGHT_FLAG:        // Если жест "вправо"
            Serial.println("Право (Следующий трек)"); 
            BT201.println("AT+CC"); // Отправка команды для перехода на следующий трек
            break;
        case GES_BACKWARD_FLAG:     // Если жест "назад"
            Serial.println("Назад (пауза/дальше)");
            BT201.println("AT+CB");
            break; 
        case GES_UP_FLAG:           // Если жест "вверх"
            Serial.println("Вверх (прибавить звук)");
            BT201.println("AT+CE");
            break;
        case GES_DOWN_FLAG:         // Если жест "вниз"
            Serial.println("Вниз (убавить звук)");
            BT201.println("AT+CF");
            break;
    }
    
    delay(500);                  // Задержка в 500 миллисекунд перед следующей итерацией цикла
}
